## drivers/char/Kconfig
```kconfig
# SPDX-License-Identifier: GPL-2.0
#
# Character device configuration
#

config XLOGCHAR
	tristate "xlogchar driver"
	help
	  A high performance log driver used by Xiaomi's logging.

source "$(KCONFIG_EXT_PREFIX)drivers/char/hw_random/Kconfig"
source "$(KCONFIG_EXT_PREFIX)drivers/char/rpmb/Kconfig"
```

## drivers/cpufreq/Kconfig
```kconfig
# SPDX-License-Identifier: GPL-2.0-only
menu "CPU Frequency scaling"

if ARM || ARM64
source "$(KCONFIG_EXT_PREFIX)drivers/cpufreq/Kconfig.arm"
endif

config MI_CPU_MAX_FREQ
	tristate "Xiaomi cpu max frequency value"
	default n
	help
	  Say 'm' here to support MI CPU MAX FREQ detection

endmenu
```

## drivers/input/fingerprint/Kconfig
```kconfig
#
# FingerprintCard fingerprint driver
#
menu "FingerprintCard fingerprint driver"
config MTK_FINGERPRINT_SUPPORT
       tristate "support driver fingerprint"
       default n
       help
	fingerprint  device.
source "$(KCONFIG_EXT_PREFIX)drivers/input/fingerprint/fpc/Kconfig"
source "$(KCONFIG_EXT_PREFIX)drivers/input/fingerprint/goodix/Kconfig"
endmenu
```

## drivers/misc/hq_kallsyms/Kconfig
```kconfig
# SPDX-License-Identifier: GPL-2.0

config HQ_KALLSYMS
	tristate "Huaqin's kallsyms lookup for modules"
	depends on KPROBES
	help
	  Looks kernel symbols up for other modules (gold's audio machine
	  drivers), with the kallsyms_lookup_name() a kprobe finds.
```

## drivers/misc/hq_notifier/Kconfig
```kconfig
# SPDX-License-Identifier: GPL-2.0

config HQ_NOTIFIER
	tristate "Huaqin's plug notifier"
	depends on TCPC_CLASS
	help
	  Tells gold's board drivers (touchscreens, switch class) when something
	  is plugged into the Type-C port or a headset into the 3.5 mm jack.
```

## drivers/misc/hqsysfs/Kconfig
```kconfig
# SPDX-License-Identifier: GPL-2.0

config HQ_SYSFS_SUPPORT
	tristate "Huaqin sysfs driver"
	help
	  Hardware and board information for Huaqin tools.
```

## drivers/misc/mediatek/simtray/Kconfig
```kconfig
# SPDX-License-Identifier: GPL-2.0

config SIMTRAY_STATUS
	tristate "Xiaomi SIM tray status"
	help
	  SIM tray GPIO detection.
```

## drivers/power/supply/battery_secrete/Kconfig
```kconfig
# SPDX-License-Identifier: GPL-2.0

config ONEWIRE_GPIO
	tristate "Battery authentication class and its one-wire GPIO"
	help
	  The battery_auth class the battery's authentication chips register
	  with, and the GPIO of their one-wire bus.

config BATT_VERIFY_BY_DS28E30
	tristate "Maxim DS28E30 battery authentication"
	depends on ONEWIRE_GPIO

config BATT_VERIFY_BY_SLG
	tristate "SLG battery authentication"
	depends on ONEWIRE_GPIO

config BATT_VERIFY_BY_ST
	tristate "ST STICK battery authentication"
	depends on ONEWIRE_GPIO

config BATT_VERIFY
	tristate "Battery authentication"
	depends on ONEWIRE_GPIO
	help
	  Authenticates the battery with whichever of its chips answers and
	  reports the result on the batt_verify power supply.
```

## drivers/switch/Kconfig
```kconfig
# SPDX-License-Identifier: GPL-2.0

config SWITCH
	tristate "Switch class support"
	depends on HQ_NOTIFIER
	help
	  Monitoring switches by userspace via sysfs and uevent.
```
